## components/drivers/Kconfig
```kconfig
menu "Device Drivers"

config RT_USING_DEVICE_IPC
    bool "Using device drivers IPC"
    default y

if RT_USING_DEVICE_IPC
    config RT_USING_SYSTEM_WORKQUEUE
        bool "Using system default workqueue"
        default n

    if RT_USING_SYSTEM_WORKQUEUE
        config RT_SYSTEM_WORKQUEUE_STACKSIZE
            int "The stack size for system workqueue thread"
            default 2048

        config RT_SYSTEM_WORKQUEUE_PRIORITY
            int "The priority level of system workqueue thread"
            default 23
    endif
endif

menuconfig RT_USING_SERIAL
    bool "USING Serial device drivers"
    select RT_USING_DEVICE_IPC
    select RT_USING_DEVICE
    default y

    if RT_USING_SERIAL
        choice
            prompt "Choice Serial version"
            default RT_USING_SERIAL_V1
            config RT_USING_SERIAL_V1
                bool "RT_USING_SERIAL_V1"
            config RT_USING_SERIAL_V2
                bool "RT_USING_SERIAL_V2"
        endchoice
        config RT_SERIAL_USING_DMA
            bool "Enable serial DMA mode"
            default y

        config RT_SERIAL_RB_BUFSZ
            int "Set RX buffer size"
            depends on !RT_USING_SERIAL_V2
            default 64
    endif

config RT_USING_HWTIMER
    bool "Using hardware timer device drivers"
    default n

config RT_USING_CPUTIME
    bool "Enable CPU time for high resolution clock counter"
    default n
    help
        When enable this option, the BSP should provide a rt_clock_cputime_ops
        for CPU time by:
        const static struct rt_clock_cputime_ops _ops = {...};
        clock_cpu_setops(&_ops);

        Then user can use high resolution clock counter with:

        ts1 = clock_cpu_gettime();
        ts2 = clock_cpu_gettime();

        /* and get the ms of delta tick with API: */
        ms_tick = clock_cpu_millisecond(t2 - t1);
        us_tick = clock_cpu_microsecond(t2 - t1);

if RT_USING_CPUTIME
    config RT_USING_CPUTIME_CORTEXM
        bool "Use DWT for CPU time"
        default y
        depends on ARCH_ARM_CORTEX_M3 || ARCH_ARM_CORTEX_M4 || ARCH_ARM_CORTEX_M7
        help
            Some Cortex-M3/4/7 MCU has Data Watchpoint and Trace Register, use
            the cycle counter in DWT for CPU time.
endif

config RT_USING_PHY
    bool "Using ethernet phy device drivers"
    default n

config RT_USING_PIN
    bool "Using generic GPIO device drivers"
    default y

config RT_USING_RTC
    bool "Using RTC device drivers"
    default n

    if RT_USING_RTC
        config RT_USING_ALARM
            bool "Using RTC alarm"
            default n

        config RT_USING_SOFT_RTC
            bool "Using software simulation RTC device"
            default n
    endif

config RT_USING_SDIO
    bool "Using SD/MMC device drivers"
    default n

    if RT_USING_SDIO
        config RT_SDIO_STACK_SIZE
            int "The stack size for sdio irq thread"
            default 512

        config RT_SDIO_THREAD_PRIORITY
            int "The priority level value of sdio irq thread"
            default 15

        config RT_MMCSD_STACK_SIZE
            int "The stack size for mmcsd thread"
            default 1024

        config RT_MMCSD_THREAD_PREORITY
            int "The priority level value of mmcsd thread"
            default 22

        config RT_MMCSD_MAX_PARTITION
            int "mmcsd max partition"
            default 16
        config RT_SDIO_DEBUG
            bool "Enable SDIO debug log output"
        default n
    endif

endmenu
```
